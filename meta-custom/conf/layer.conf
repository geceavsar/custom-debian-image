## meta-custom/conf/layer.conf
```bitbake
LAYERSERIES_COMPAT_meta-custom = "v0.11 next"
LAYERDIR_meta-custom = "${LAYERDIR}"

BBPATH .= ":${LAYERDIR}"
BBFILE_COLLECTIONS += "meta-custom"
BBFILE_PATTERN_meta-custom = "^${LAYERDIR}/recipes-*"
BBFILE_PRIORITY_meta-custom = "6"

BBFILES += "${LAYERDIR}/recipes-*/*/*.bb \
            ${LAYERDIR}/recipes-*/*/*.bbappend"

DISTRO_APT_SOURCES += "conf/apt-config/sources-list/bullseye.list"
DISTRO_APT_SOURCES += "conf/apt-config/sources-list/bookworm.list"
DISTRO_APT_SOURCES += "../isar/meta/conf/distro/debian-trixie.list"
DISTRO_APT_PREFERENCES += "conf/apt-config/package-preferences/custom-packages.pref"
```
